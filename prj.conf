## CMakeLists.txt
```
cmake_minimum_required(VERSION 3.20.0)
set(SHIELD ssd1306_128x32)
find_package(Zephyr REQUIRED HINTS $ENV{ZEPHYR_BASE})

project(TX-RX)

file(GLOB_RECURSE APP_SOURCES "src/*.c")

list(FILTER APP_SOURCES EXCLUDE REGEX ".*/others/.*")
list(FILTER APP_SOURCES EXCLUDE REGEX "/drivers/display_handler.*")
list(FILTER APP_SOURCES EXCLUDE REGEX "/fsm/fsm.c")

target_sources(app PRIVATE ${APP_SOURCES})
```

## prj.conf
```kconfig
####### APPLICAITON 
# Switches if Sensor(y) or Gateway (n) mode 
CONFIG_SENSOR=y
#BME280 driver when a BME280 node is present
# CONFIG_BME280=y
CONFIG_I2C=y

##### ZEPHYR and BOARD CONFIGS
CONFIG_DK_LIBRARY=y
CONFIG_LOG=y
CONFIG_LOG_MODE_IMMEDIATE=y
CONFIG_LOG_PRINTK=y

##### Logs configuration
## To enable full logging, set to level 3 and disable second option to avoid duplicates
## To disable loggins, set level to 0 and enable second option to enable printk usage
CONFIG_LOG_DEFAULT_LEVEL=3
CONFIG_UART_CONSOLE=y

CONFIG_PRINTK=y
CONFIG_CONSOLE=y
CONFIG_LOG_BACKEND_UART=y
CONFIG_STDOUT_CONSOLE=y
# CONFIG_MODEM_ANTENNA_AT_MAGPIO=""
# CONFIG_MODEM_ANTENNA_AT_COEX0=""
CONFIG_NRF_MODEM_LOG=n
CONFIG_NRF_MODEM_LIB_LOG_LEVEL_DBG=n
CONFIG_PRINTK=y
CONFIG_NEWLIB_LIBC=y
CONFIG_NEWLIB_LIBC_FLOAT_PRINTF=y

# For NRF9151
CONFIG_NRF_MODEM_LIB=y
CONFIG_MODEM_ANTENNA=n
CONFIG_NRF_MODEM_LINK_BINARY_DECT_PHY=y
CONFIG_HWINFO=y

CONFIG_SERIAL=y
CONFIG_UART_ASYNC_API=y
CONFIG_UART_INTERRUPT_DRIVEN=y

# For display
# CONFIG_LV_Z_MEM_POOL_NUMBER_BLOCKS=8
# Note: LVGL pool symbol may not be available in this Zephyr/Kconfig set.
# Uncomment only if your Zephyr tree defines this symbol.
# CONFIG_LV_Z_SHELL=y
# CONFIG_MAIN_STACK_SIZE=4096
# CONFIG_DISPLAY=y
# CONFIG_DISPLAY_LOG_LEVEL_ERR=y
# CONFIG_SSD1306=y
# # CONFIG_SSD1306_REVERSE_MODE=n
# # Note: SSD1306_REVERSE_MODE may not exist in all SSD1306 drivers. Leave commented
# # unless your driver Kconfig exposes this symbol.
# CONFIG_SHELL=y
# CONFIG_LVGL=y
# # CONFIG_LV_MEM_CUSTOM=y
# CONFIG_LV_USE_LOG=y
# CONFIG_LV_USE_LABEL=y
# # CONFIG_LV_USE_BTN=y
# # CONFIG_LV_USE_IMG=y
# # Note: LVGL component-level symbols (LV_USE_*) are often controlled by the LVGL
# # integration Kconfig; only enable them if present in your Zephyr version.
# CONFIG_LV_USE_MONKEY=y
# CONFIG_LV_FONT_MONTSERRAT_14=y

# ### FOR USE WITH PRODUCTION BOARDS. NOTE FROM IVÁN: DO NOT ENABLE
# CONFIG_LOG=y
# CONFIG_LOG_MAX_LEVEL= 4
# CONFIG_DEBUG=y
# CONFIG_PRINTK=y
# CONFIG_USE_SEGGER_RTT=y
# CONFIG_RTT_CONSOLE=y
# CONFIG_UART_CONSOLE=n
# CONFIG_LOG_MODE_MINIMAL=y

# CONFIG_UART_3_ASYNC=y

# CONFIG_UART_3_NRF_HW_ASYNC=y 
# CONFIG_UART_3_NRF_HW_ASYNC_TIMER=1

# CONFIG_SPI=y
# CONFIG_GPIO=y

# Allow printing of floats in printk and logs
CONFIG_CBPRINTF_FP_SUPPORT=y
CONFIG_CBPRINTF_COMPLETE=y
CONFIG_LOG_PRINTK=y
CONFIG_STDOUT_CONSOLE=y
```

## src/main.c
```c
// /******************************************************************************

// DECT NR+ implementation in progress
// Property of Universidad Politécnica de Cartagena, QARTIA Department.
// Author: Iván Tomás García (ivan.tomas@edu.upct.es)
// Start project date: 4/3/2023

// ****************************************************************************
// TODO:
// - A lot
// ****************************************************************************/


#include <zephyr/kernel.h>
#include <zephyr/logging/log.h>

#include "app/app_state.h"
#include "drivers/uart_handler.h"
#include "drivers/gpio_handler.h"
#include "drivers/modem_handler.h"
#include "drivers/sensor_bme280.h"
#include "drivers/sensor_htu21d.h"
// #include "drivers/display_handler.h"
#include "common/utils.h"
#include "common/data_buffers.h"
#include "config/device_config.h"
#include "app/applications.h"

LOG_MODULE_REGISTER(app);

static void app_run_thread(void *p1, void *p2, void *p3)
{
    ARG_UNUSED(p1); ARG_UNUSED(p2); ARG_UNUSED(p3);
    app();
}

K_THREAD_DEFINE(app_run_tid, 4096, app_run_thread, NULL, NULL, NULL,
                5, 0, 0);



int main(void)
{

    while (1)
    {
        //// YOUR APPLICATION FUNCTION HERE ////









        /// Example functions from applications.c ///
        if(IS_GATEWAY)
        {
            // print_sensor_data();
            print_data();
        }
        else
        {
            if(read_sensors_task() != 0)
                generate_dummy_data();
        }
        //// Leave a thread sleep to allow other threads to run
        k_msleep(1);
    }

    return 0;
}
```
