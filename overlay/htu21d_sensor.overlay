&i2c2 {
    status = "okay";

    htu21d: htu21d@40 {
        compatible = "meas,htu21d";   // Not used, purely decorative
        reg = <0x40>;
        label = "HTU21D_RAW";
    };
};

&i2c2_default {
    group1 {
        psels = <NRF_PSEL(TWIM_SDA, 0, 21)>, <NRF_PSEL(TWIM_SCL, 0, 25)>;
    };
};